## Config.in
```kconfig
source "$BR2_EXTERNAL_GAMEPAD_KVM_PATH/package/gameview-backend/Config.in"
source "$BR2_EXTERNAL_GAMEPAD_KVM_PATH/package/gameview-usbgadget/Config.in"
source "$BR2_EXTERNAL_GAMEPAD_KVM_PATH/package/gameview-website/Config.in"
```

## configs/gamepad_kvm_rock3c_defconfig
```kconfig
BR2_aarch64=y
BR2_cortex_a72_a53=y
BR2_PACKAGE_HOST_LINUX_HEADERS_CUSTOM_6_1=y
BR2_GLOBAL_PATCH_DIR="../gamepad-kvm/board/radxa/rock-3c/patches"
BR2_DOWNLOAD_FORCE_CHECK_HASHES=y
BR2_TARGET_GENERIC_HOSTNAME="rock3c"
BR2_TARGET_GENERIC_ISSUE="Welcome to Buildroot for Radxa Rock 3C"
BR2_ROOTFS_OVERLAY="../gamepad-kvm/board/radxa/rock-3c/rootfs_overlay"
BR2_ROOTFS_POST_BUILD_SCRIPT="../gamepad-kvm/board/radxa/rock-3c/post-build.sh"
BR2_ROOTFS_POST_IMAGE_SCRIPT="support/scripts/genimage.sh"
BR2_ROOTFS_POST_SCRIPT_ARGS="-c ../gamepad-kvm/board/radxa/rock-3c/genimage.cfg"
BR2_LINUX_KERNEL=y
BR2_LINUX_KERNEL_CUSTOM_GIT=y
BR2_LINUX_KERNEL_CUSTOM_REPO_URL="https://github.com/radxa/kernel.git"
BR2_LINUX_KERNEL_CUSTOM_REPO_VERSION="3bbac32c942f4d98fc87bde3852f185dce56ff56"
BR2_LINUX_KERNEL_VERSION="3bbac32c942f4d98fc87bde3852f185dce56ff56"
BR2_LINUX_KERNEL_USE_CUSTOM_CONFIG=y
BR2_LINUX_KERNEL_CUSTOM_CONFIG_FILE="../gamepad-kvm/board/radxa/rock-3c/6-1_kernel_defconfig"
BR2_LINUX_KERNEL_IMAGE=y
BR2_LINUX_KERNEL_GZIP=y
BR2_LINUX_KERNEL_DTS_SUPPORT=y
BR2_LINUX_KERNEL_INTREE_DTS_NAME="rockchip/rk3566-rock-3c"
BR2_LINUX_KERNEL_DTB_OVERLAY_SUPPORT=y
BR2_LINUX_KERNEL_INSTALL_TARGET=y
BR2_LINUX_KERNEL_NEEDS_HOST_OPENSSL=y
BR2_LINUX_KERNEL_NEEDS_HOST_PAHOLE=y
BR2_TARGET_ROOTFS_EXT2=y
BR2_TARGET_ROOTFS_EXT2_4=y
BR2_TARGET_ROOTFS_EXT2_SIZE="512M"
BR2_PACKAGE_HOST_GENIMAGE=y
```
